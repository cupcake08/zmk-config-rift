## boards/shields/rift/Kconfig.defconfig
```kconfig
if SHIELD_RIFT_LEFT

config ZMK_KEYBOARD_NAME
    default "RIFT"

config ZMK_SPLIT_BLE_ROLE_CENTRAL
    default y

endif # LEFT

if SHIELD_RIFT_LEFT || SHIELD_RIFT_RIGHT

    config ZMK_SPLIT
        default y

endif
```

## boards/shields/rift/Kconfig.shield
```kconfig
config SHIELD_RIFT_LEFT
    def_bool $(shields_list_contains,rift_left)

config SHIELD_RIFT_RIGHT
    def_bool $(shields_list_contains,rift_right)
```
