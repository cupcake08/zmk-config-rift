#include "rift.dtsi"

&default_transform {
	col-offset = <5>;
};

&kscan0 {
	col-gpios
		= <&shifter 1 GPIO_ACTIVE_HIGH>
		, <&shifter 2 GPIO_ACTIVE_HIGH>
		, <&shifter 3 GPIO_ACTIVE_HIGH>
		, <&shifter 4 GPIO_ACTIVE_HIGH>
		, <&shifter 5 GPIO_ACTIVE_HIGH>
		;
};

&right_encoder {
    status = "okay";
};